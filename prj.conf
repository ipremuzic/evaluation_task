## CMakeLists.txt
```
cmake_minimum_required(VERSION 3.20.0)

find_package(Zephyr REQUIRED HINTS $ENV{ZEPHYR_BASE})
project(evaluation_task)

target_sources(app PRIVATE src/main.cpp src/middleware/middleware.cpp src/hal/hal.cpp)

target_include_directories(app PRIVATE ${CMAKE_CURRENT_LIST_DIR}/src/hal ${CMAKE_CURRENT_LIST_DIR}/src/middleware)
```

## prj.conf
```kconfig
CONFIG_CPP=y
CONFIG_REQUIRES_FULL_LIBCPP=y

CONFIG_LOG=y

CONFIG_GPIO=y

CONFIG_ZBUS=y
CONFIG_ZBUS_RUNTIME_OBSERVERS=y
```

## app.overlay
```dts
/ {
    aliases {
        led0 = &green_led_2;
        btn0 = &user_button;
    };
};
```

## src/main.cpp
```c
#include <cstdint>
#include <zephyr/logging/log.h>

#include "middleware.hpp"

LOG_MODULE_REGISTER(main, LOG_LEVEL_DBG);


int main(void)
{
	int ret;
	ReadClass readobj;
	ReactClass reactobj;

	ret = readobj.setup_input_gpio();
	if (ret) {
		LOG_ERR("Failed to setup input GPIO");
		return 0;
	}

	ret = readobj.register_cb();
	if (ret) {
		LOG_ERR("Failed to register input interrupt callback");
		return 0;
	}

	ret = reactobj.setup_output_gpio();
	if (ret){
		LOG_ERR("Failed to setup output GPIO");
		return 0;
	}

	ret = reactobj.register_observer();
	if (ret) {
		LOG_ERR("Failed to register observer");
		return 0;
	}

	LOG_INF("App initialized successfully");

	return 0;
}
```
